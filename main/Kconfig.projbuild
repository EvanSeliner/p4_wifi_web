## main/Kconfig.projbuild
```kconfig
menu "P4 Debug Options"

config P4_DEBUG_ENABLE_I2C_SMOKE
    bool "Enable I2C/SCCB smoke test"
    default y
    help
        When enabled, app will scan I2C bus and attempt to read OV5647 chip ID.

config P4_SCCB_PORT
    int "I2C port for SCCB (0..2)"
    depends on P4_DEBUG_ENABLE_I2C_SMOKE
    range 0 2
    default 0

config P4_SCCB_SDA_GPIO
    int "SCCB SDA GPIO"
    depends on P4_DEBUG_ENABLE_I2C_SMOKE
    default -1

config P4_SCCB_SCL_GPIO
    int "SCCB SCL GPIO"
    depends on P4_DEBUG_ENABLE_I2C_SMOKE
    default -1

config P4_I2C_SMOKE_SPEED_HZ
    int "I2C smoke test speed (Hz)"
    depends on P4_DEBUG_ENABLE_I2C_SMOKE
    default 100000

endmenu
```

## sdkconfig.defaults
```kconfig
CONFIG_SPIRAM=y
CONFIG_IDF_TARGET="esp32p4"

# Camera: OV5647 on MIPI-CSI with XCLK via clock router
CONFIG_CAMERA_OV5647=y
CONFIG_CAMERA_XCLK_USE_ESP_CLOCK_ROUTER=y
CONFIG_ESP_VIDEO_ENABLE_MIPI_CSI_VIDEO_DEVICE=y

# SCCB/I2C on Waveshare CSI header (port 0, SDA=7, SCL=8)
# Note: When the debug menu is disabled, main.c falls back to these exact pins.
CONFIG_P4_SCCB_PORT=0
CONFIG_P4_SCCB_SDA_GPIO=7
CONFIG_P4_SCCB_SCL_GPIO=8
CONFIG_P4_SCCB_RESET_GPIO=-1
CONFIG_P4_SCCB_PWDN_GPIO=-1

# Keep legacy-vs-NG I2C from aborting if smoke is enabled
CONFIG_I2C_SKIP_LEGACY_CONFLICT_CHECK=y

# Optional: disable I2C smoke by default (enable in menu for scans/ID)
CONFIG_P4_DEBUG_ENABLE_I2C_SMOKE=n

# WebSocket support for /ws endpoint
CONFIG_HTTPD_WS_SUPPORT=y
```
